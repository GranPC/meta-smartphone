## meta-asus/conf/machine/_flo.conf
```bitbake
require conf/machine/include/bsp-android-hybris.inc

ANDROID_BOARD_BOOTIMAGE_PARTITION = "/dev/block/mmcblk0p14"
ANDROID_BOARD_SYSTEMIMAGE_PARTITION_SIZE = "880803840"
ANDROID_BOARD_FLASH_BLOCK_SIZE = "131072"

PREFERRED_PROVIDER_virtual/android-headers = "android-headers"
```

## meta-asus/conf/machine/flo.conf
```bitbake
#-----------------------------------------------------------------------------
#@TYPE: Machine
#@NAME: Asus Grouper (also known as Google Nexus 7)
#@DESCRIPTION: Machine configuration for the Asus Grouper
#-----------------------------------------------------------------------------

TARGET_ARCH = "arm"

MACHINE_CLASS = "flo"

PREFERRED_PROVIDER_virtual/kernel ?= "linux-asus-flo"
MACHINE_KERNEL_PR = "r1"

MACHINE_FEATURES = "kernel26 apm alsa bluetooth gps usbgadget usbhost wifi vfat ext2"
MACHINE_DISPLAY_WIDTH_PIXELS = "1200"
MACHINE_DISPLAY_HEIGHT_PIXELS = "1920"
MACHINE_DISPLAY_ORIENTATION = "0"
MACHINE_DISPLAY_PPI = "320"

# MACHINE_EXTRA_RDEPENDS = "asus-flo-firmware"

PREFERRED_PROVIDER_virtual/egl ?= "libhybris"
PREFERRED_PROVIDER_virtual/libgles1 ?= "libhybris"
PREFERRED_PROVIDER_virtual/libgles2 ?= "libhybris"
PREFERRED_PROVIDER_virtual/libandroid-properties ?= "libhybris"
PREFERRED_PROVIDER_virtual/libhardware ?= "libhybris"

PREFERRED_PROVIDER_virtual/android-headers = "phablet-headers"

VIRTUAL-RUNTIME_android-system-image ?= "android-system-image-flo"

PREFERRED_PROVIDER_virtual/xserver = "xserver-xorg"
XSERVER = " \
    xserver-xorg \
    xf86-input-evdev \
"

KERNEL_IMAGETYPE = "zImage"
IMAGE_FSTYPES += "tar.gz ext2 ext4"
IMAGE_ROOTFS_EXTRA_SPACE = "200000"

ANDROID_BOARD_BOOTIMAGE_PARTITION = "/dev/block/mmcblk0p14"
ANDROID_BOARD_SYSTEMIMAGE_PARTITION_SIZE = "880803840"
ANDROID_BOARD_FLASH_BLOCK_SIZE = "131072"

require conf/machine/include/tune-cortexa8.inc
```
